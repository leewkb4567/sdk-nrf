## samples/adafruit/lcd/sample.yaml
```yaml
sample:
  description: nRF52 / nRF91 SEEED LCD demo
  name: seeed_lcd
tests:
  test_build:
    build_only: true
    build_on_all: true
    platform_whitelist: nrf52_pca10040 nrf52810_pca10040 nrf52840_pca10056 nrf9160_pca10090
    tags: ci_build
```
